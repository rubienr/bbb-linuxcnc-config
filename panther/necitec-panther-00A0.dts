/*
 * Necitec Panther Cape device tree overlay
 */

/dts-v1/;
/plugin/;

/{
    compatible = "ti,beaglebone", "ti,beaglebone-black";
    part_number = "necitec-panther";
    version ="00A0";

    exclusive-use =
        "P9.11", // gpio0.30, PIN 28, GPIO 30
        "P9.13", // gpio0.31, PIN 29, GPIO 31
        "P9.15", // gpio1.16, PIN 16, GPIO 48
        "P8.17", // gpio0.27, PIN 11, GPIO 27
        "P9.23", // gpio1.17, PIN 17, GPIO 49 
        "P9.25", // gpio3.21, PIN 107,GPIO 117 
        "P9.27", // gpio3.19, PIN 105,GPIO 115
        "P9.26", // gpio0.14, PIN 96, GPIO 14

        "P9.24", // gpio0.15, PIN 97, GPIO 15
        "P8.26", // gpio1.29, PIN 31, GPIO 61
        "P9.12", // gpio1.28, PIN 30, GPIO 60
        "P8.15", // gpio1.15, PIN 15, GPIO 47
        "P9.42", // gpio0.7,  PIN 89, GPIO 7   
        "P8.18", // gpio2.1,  PIN 35, GPIO 65   
        "P9.22", // gpio0.2,  PIN 84, GPIO 2   
        "P9.21", // gpio0.3,  PIN 85, GPIO 3

        "P8.9",  // gpio2.5,  PIN 39, GPIO 69 
        "P8.7",  // gpio2.2,  PIN 36, GPIO 66
        "P8.8",  // gpio2.3,  PIN 37, GPIO 67 
        "P8.10", // gpio2.4,  PIN 38, GPIO 68 
        "P8.12", // gpio1.12, PIN 12, GPIO 44
        "P8.11", // gpio1.13, PIN 13, GPIO 45
        "P8.14", // gpio0.26, PIN 10, GPIO 26
        "P8.16", // gpio1.14, PIN 14, GPIO 46

        "P8.13", // gpio0.23, PIN 9,  GPIO 23
        "P8.19", // gpio0.22, PIN 8,  GPIO 22 
        "P9.14", // gpio1.18, PIN 18, GPIO 50
        "P9.16", // gpio1.19, PIN 19, GPIO 51
        "P9.17", // gpio0.5,  PIN 87, GPIO 5
        "P9.18", // gpio0.4,  PIN 86, GPIO 4

        "gpio0.30", // P9.11
        "gpio0.31", // P9.13
        "gpio1.16", // P9.15
        "gpio0.27", // P8.17
        "gpio1.17", // P9.23
        "gpio3.21", // P9.25
        "gpio3.19", // P9.27
        "gpio0.14", // P9.26

        "gpio0.15", // P9.24
        "gpio1.29", // P8.26
        "gpio1.28", // P9.12
        "gpio1.15", // P8.15
        "gpio0.7",  // P9.42
        "gpio2.1",  // P8.18
        "gpio0.2",  // P9.22
        "gpio0.3",  // P9.21

        "gpio2.5",  // P8.9"
        "gpio2.2",  // P8.7"
        "gpio2.3",  // P8.8"
        "gpio2.4",  // P8.10
        "gpio1.12", // P8.12
        "gpio1.13", // P8.11
        "gpio0.26", // P8.14
        "gpio1.14", // P8.16

        "gpio0.23", // P8.13
        "gpio0.22", // P8.19
        "gpio1.18", // P9.14
        "gpio1.19", // P9.16
        "gpio0.5",  // P9.17
        "gpio0.4",  // P9.18

        "pru0";     // programmable realtime unit 0

    fragment@0 {
        target = <&am33xx_pinmux>;
        __overlay__ {
            necitec_panther_pins: pinmux_necitec_panther_pins {
                pinctrl-single,pins = <
                    // inputs: pull-up, pad mode is gpio
                    0x070 0x37 // PIN 9.11
                    0x074 0x37 // PIN 9.13
                    0x040 0x37 // PIN 9.15
                    0x02c 0x37 // PIN 8.17
                    0x044 0x37 // PIN 9.23
                    0x1ac 0x37 // PIN 9.25
                    0x1a4 0x37 // PIN 9.27
                    0x180 0x37 // PIN 9.26

                    0x184 0x37 // PIN 9.24
                    0x07c 0x37 // PIN 8.26
                    0x078 0x37 // PIN 9.12
                    0x03c 0x37 // PIN 8.15
                    0x164 0x37 // PIN 9.42
                    0x08c 0x37 // PIN 8.18
                    0x150 0x37 // PIN 9.22
                    0x154 0x37 // pIN 9.21

                    // outputs: pull-down, pad mode is gpio
                    0x09c 0x07 // PIN 8.9
                    0x090 0x07 // PIN 8.7
                    0x094 0x07 // PIN 8.8
                    0x098 0x07 // PIN 8.10
                    0x030 0x07 // PIN 8.12
                    0x034 0x07 // PIN 8.11
                    0x028 0x07 // PIN 8.14
                    0x038 0x07 // PIN 8.16

                    0x024 0x07 // PIN 8.13
                    0x020 0x07 // PIN 8.19
                    0x048 0x07 // PIN 9.14
                    0x04c 0x07 // PIN 9.16
                    0x15c 0x07 // PIN 9.17
                    0x158 0x07 // PIN 9.18
                >;
            };
        };
    };

    fragment@1 {
        target = <&pruss>;
        __overlay__ {
                status = "okay";
                pinctrl-names = "default";
                pinctrl-0 = <&necitec_panther_pins>;
        };
    };
};
